## CMakeLists.txt
```
#
# Copyright (c) 2021 Nordic Semiconductor
#
# SPDX-License-Identifier: LicenseRef-Nordic-5-Clause
#

cmake_minimum_required(VERSION 3.13.1)

find_package(Zephyr REQUIRED HINTS $ENV{ZEPHYR_BASE})
project(data_module_test)

# generate runner for the test
test_runner_generate(src/data_module_test.c)

# create mock
cmock_handle(../../src/modules/modules_common.h )
cmock_handle(../../src/cloud/cloud_codec/cloud_codec.h )
cmock_handle(${NRF_DIR}/include/event_manager.h )
cmock_handle(${NRF_DIR}/subsys/event_manager/event_manager_priv.h)
cmock_handle(${NRF_DIR}/include/date_time.h )
cmock_handle(${NRF_DIR}/modules/cjson/include/cJSON_os.h)
cmock_handle(${ZEPHYR_BASE}/include/settings/settings.h settings)
#cmock_handle(${ZEPHYR_BASE}/include/sys/reboot.h sys)

# add the unit under test
target_sources(app PRIVATE ../../src/modules/data_module.c)

# add test file
target_sources(app PRIVATE src/data_module_test.c)

target_include_directories(app PRIVATE .)
target_include_directories(app PRIVATE ../../src/)
target_include_directories(app PRIVATE ../../src/modules/)
target_include_directories(app PRIVATE ../../src/events/)
target_include_directories(app PRIVATE ${NRF_DIR}/subsys/event_manager)
target_include_directories(app PRIVATE ${NRF_DIR}/subsys/event_manager_profiler_tracer/ )
target_include_directories(app PRIVATE ${NRF_DIR}/modules/cjson/include)
target_include_directories(app PRIVATE ${ZEPHYR_NRFXLIB_MODULE_DIR}/nrf_modem/include/ )

# Options that cannot be passed through kconfig fragments.
target_compile_definitions(app PRIVATE
  	CONFIG_ASSET_TRACKER_V2_APP_VERSION_MAX_LEN=20
	CONFIG_EVENT_MANAGER_MAX_EVENT_CNT=32)
```

## Kconfig
```
# Config options for logger sample app
#
# Copyright (c) 2021 Nordic Semiconductor ASA
#
# SPDX-License-Identifier: LicenseRef-Nordic-5-Clause
#
source "Kconfig.zephyr"

source "${ZEPHYR_BASE}/../nrf/applications/asset_tracker_v2/src/modules/Kconfig.data_module"
```

## prj.conf
```kconfig
#
# Copyright (c) 2021 Nordic Semiconductor ASA
#
# SPDX-License-Identifier: LicenseRef-Nordic-5-Clause
#
CONFIG_UNITY=y
CONFIG_DATE_TIME_NTP=n
```

## src/data_module_test.c
```c
/*
 * Copyright (c) 2021 Nordic Semiconductor ASA
 *
 * SPDX-License-Identifier: LicenseRef-Nordic-5-Clause
 */
#include <unity.h>
#include <stdlib.h>
#include <mock_modules_common.h>
#include <mock_event_manager.h>
#include <mock_cJSON_os.h>
#include <mock_date_time.h>
#include <settings/mock_settings.h>

extern struct event_listener __event_listener_data_module;
extern struct _static_thread_data _k_thread_data_data_module_thread;

static k_tid_t data_module_thread_id;

#define DATA_MODULE_EVT_HANDLER(eh) __event_listener_data_module.notification(eh)
#define DATA_MODULE_INIT_ENTRY _k_thread_data_data_module_thread.init_entry

/* Dummy functions and objects. */

/* The following function needs to be stubbed this way because event manager
 * uses heap to allocate memory for events.
 * The other alternative is to mock the k_malloc using CMock framework, but
 * that will pollute the test code and will be an overkill.
 */
void *k_malloc(size_t size)
{
	return malloc(size);
}

/* Dummy structs to please linker. The EVENT_SUBSCRIBE macros in gps_module.c
 * depend on these to exist. But since we are unit testing, we dont need
 * these subscriptions and hence these structs can remain uninitialized.
 */
const struct event_type __event_type_gnss_module_event;
const struct event_type __event_type_app_module_event;
const struct event_type __event_type_data_module_event;
const struct event_type __event_type_util_module_event;
const struct event_type __event_type_modem_module_event;
const struct event_type __event_type_cloud_module_event;
const struct event_type __event_type_sensor_module_event;
const struct event_type __event_type_ui_module_event;

/* Dummy functions and objects - End.  */

/* The following is required because unity is using a different main signature
 * (returns int) and zephyr expects main to not return value.
 */
extern int unity_main(void);

/* Suite teardown shall finalize with mandatory call to generic_suiteTearDown. */
extern int generic_suiteTearDown(int num_failures);

int test_suiteTearDown(int num_failures)
{
	return generic_suiteTearDown(num_failures);
}

void setUp(void)
{
	mock_modules_common_Init();
	mock_event_manager_Init();
}

void tearDown(void)
{
	mock_modules_common_Verify();
	mock_event_manager_Verify();
}

int module_start_callback(struct module_data *module, int number_of_calls)
{
	data_module_thread_id = module->thread_id;

	printf("Thread ID known!!");
	//k_thread_suspend(data_module_thread_id);
	return 0;
}

void test_data_module_start(void)
{
	__wrap_module_start_ExpectAnyArgsAndReturn(9);
	__wrap_module_start_AddCallback(&module_start_callback);
	__wrap_settings_load_subtree_ExpectAnyArgsAndReturn(0);
	__wrap_settings_subsys_init_ExpectAndReturn(0);
	__wrap_cJSON_Init_Expect();
	__wrap_module_get_next_msg_ExpectAnyArgsAndReturn(0);
	__wrap_date_time_register_handler_ExpectAnyArgs();

	/* Stimulus: Simulate a call to spawn the data module thread. */
	DATA_MODULE_INIT_ENTRY(NULL, NULL, NULL);

	/* Now that the thread ID of the data module should be available in the unit test, suspend the
	 * thread in order to avoid the kernel spawing the thread unnecessarily. */
	//k_thread_suspend(data_module_thread_id);
	//k_thread_abort(data_module_thread_id);
}

void main(void)
{
	(void)unity_main();
}
```
