## CMakeLists.txt
```
#
# Copyright (c) 2021 Nordic Semiconductor
#
# SPDX-License-Identifier: LicenseRef-Nordic-5-Clause
#

cmake_minimum_required(VERSION 3.13.1)

set(UNITY_CONFIG_FILE unity_cfg.yaml CACHE STRING "")
find_package(Zephyr REQUIRED HINTS $ENV{ZEPHYR_BASE})
project(debug_module_test)

# Set CMake path variables for convenience
set(MEMFAULT_SDK_DIR ${ZEPHYR_BASE}/../modules/lib/memfault-firmware-sdk)
set(NRF_SDK_DIR ${ZEPHYR_BASE}/../nrf)
set(ASSET_TRACKER_V2_DIR ../..)

# Generate runner for the test
test_runner_generate(src/debug_module_test.c)

# Create mock for Memfault SDK source files
cmock_handle(${MEMFAULT_SDK_DIR}/components/include/memfault/metrics/metrics.h memfault/metrics)
cmock_handle(${MEMFAULT_SDK_DIR}/ports/zephyr/include/memfault/ports/zephyr/http.h memfault/ports/zephyr)
cmock_handle(${MEMFAULT_SDK_DIR}/components/include/memfault/core/data_packetizer.h memfault/core)
cmock_handle(${MEMFAULT_SDK_DIR}/components/include/memfault/core/trace_event.h memfault/core)
cmock_handle(${MEMFAULT_SDK_DIR}/ports/include/memfault/ports/watchdog.h memfault/ports)
cmock_handle(${ZEPHYR_BASE}/../zephyr/include/sys/reboot.h sys)

# Create mock for nRF SDK
cmock_handle(${NRF_SDK_DIR}/include/event_manager.h)

# Create mock for Asset Tracker v2 application source files
cmock_handle(${ASSET_TRACKER_V2_DIR}/src/modules/modules_common.h)
cmock_handle(${ASSET_TRACKER_V2_DIR}/src/watchdog/watchdog_app.h watchdog)
#cmock_handle(${ASSET_TRACKER_V2_DIR}/configuration/memfault/memfault_platform_config.h configuration/memfault)

# Add gps_module (Unit Under Test)
target_sources(app PRIVATE ${ASSET_TRACKER_V2_DIR}/src/modules/debug_module.c)

# Add test source file
target_sources(app PRIVATE src/debug_module_test.c)

# Include Asset Tracker v2 application folders
target_include_directories(app PRIVATE .)
target_include_directories(app PRIVATE ${ASSET_TRACKER_V2_DIR}/src/)
target_include_directories(app PRIVATE ${ASSET_TRACKER_V2_DIR}/src/watchdog)
target_include_directories(app PRIVATE ${ASSET_TRACKER_V2_DIR}/src/modules/)
target_include_directories(app PRIVATE ${ASSET_TRACKER_V2_DIR}/src/events/)
target_include_directories(app PRIVATE ${ASSET_TRACKER_V2_DIR}/configuration/memfault/)

# Include nRF SDK directories
target_include_directories(app PRIVATE ${NRF_SDK_DIR}/subsys/event_manager)
target_include_directories(app PRIVATE ${NRF_SDK_DIR}/modules/cjson/include)

# Include Memfault SDK directories
target_include_directories(app PRIVATE ${MEMFAULT_SDK_DIR}/components/include/)
target_include_directories(app PRIVATE ${MEMFAULT_SDK_DIR}/components/include/core)

# Options that cannot be passed through Kconfig fragments.
target_compile_options(app PRIVATE
  	-DCONFIG_ASSET_TRACKER_V2_APP_VERSION_MAX_LEN=20
	-DCONFIG_DEBUG_MODULE_LOG_LEVEL=4
	-DCONFIG_MEMFAULT=y
)
```

## Kconfig
```
#
# Copyright (c) 2021 Nordic Semiconductor ASA
#
# SPDX-License-Identifier: LicenseRef-Nordic-5-Clause
#

mainmenu "Debug module Unity test"

menu "Debug module configuration"

config UUT_PARAM_CHECK
	bool "Enabled function parameter check"

endmenu

rsource "../../src/modules/Kconfig.debug_module"
source "Kconfig.zephyr"
```

## prj.conf
```kconfig
#
# Copyright (c) 2021 Nordic Semiconductor ASA
#
# SPDX-License-Identifier: LicenseRef-Nordic-5-Clause
#

CONFIG_UNITY=y
CONFIG_DEBUG_MODULE=y
CONFIG_HEAP_MEM_POOL_SIZE=10240
CONFIG_MAIN_STACK_SIZE=4096
CONFIG_DEBUG_MODULE_USE_CUSTOM_TRANSPORT=y
```

## src/debug_module_test.c
```c
/*
 * Copyright (c) 2021 Nordic Semiconductor ASA
 *
 * SPDX-License-Identifier: LicenseRef-Nordic-5-Clause
 */
#include <unity.h>
#include <stdbool.h>
#include <stdlib.h>
#include <mock_modules_common.h>
#include <mock_event_manager.h>
#include <watchdog/mock_watchdog_app.h>
#include <memfault/metrics/mock_metrics.h>
#include <memfault/core/mock_data_packetizer.h>

#include "app_module_event.h"
#include "gps_module_event.h"
#include "debug_module_event.h"
#include "data_module_event.h"

extern struct event_listener __event_listener_debug_module;

#define DEBUG_MODULE_EVT_HANDLER(eh) __event_listener_debug_module.notification(eh)

const char * const g_memfault_metrics_id_GPSFixSatellitesTracked;
const char * const g_memfault_metrics_id_GpsTimeToFix;
const char * const g_memfault_metrics_id_GpsTimeoutSatellitesTracked;
const char * const g_memfault_metrics_id_GpsTimeoutSearchTime;

/* Dummy structs to please linker. The EVENT_SUBSCRIBE macros in debug_module.c
 * depend on these to exist. But since we are unit testing, we dont need
 * these subscriptions and hence these structs can remain uninitialized.
 */
const struct event_type __event_type_gps_module_event;
const struct event_type __event_type_debug_module_event;
const struct event_type __event_type_app_module_event;
const struct event_type __event_type_data_module_event;
const struct event_type __event_type_cloud_module_event;
const struct event_type __event_type_modem_module_event;
const struct event_type __event_type_sensor_module_event;
const struct event_type __event_type_ui_module_event;
const struct event_type __event_type_util_module_event;

/* The following is required because unity is using a different main signature
 * (returns int) and zephyr expects main to not return value.
 */
extern int unity_main(void);

/* Suite teardown finalizes with mandatory call to generic_suiteTearDown. */
extern int generic_suiteTearDown(int num_failures);

static watchdog_evt_handler_t debug_module_watchdog_evt_handler;

int test_suiteTearDown(int num_failures)
{
	return generic_suiteTearDown(num_failures);
}

static void watchdog_callback(watchdog_evt_handler_t handler, int number_of_calls)
{
	/* Latch thew for future use. */
	debug_module_watchdog_evt_handler = handler;
}

static void validate_debug_data_ready_evt(struct event_header *eh, int no_of_calls)
{
	struct debug_module_event *event = cast_debug_module_event(eh);

	TEST_ASSERT_EQUAL(DEBUG_EVT_MEMFAULT_DATA_READY, event->type);
}

static void setup_debug_module_in_init_state(void)
{
	struct app_module_event *app_module_event = new_app_module_event();

	app_module_event->type = APP_EVT_START;

	static struct module_data expected_module_data = {
		.name = "debug",
		.msg_q = NULL,
		.supports_shutdown = true,
	};

	__wrap_watchdog_register_handler_AddCallback(&watchdog_callback);
	__wrap_module_start_ExpectAndReturn(&expected_module_data, 0);

	TEST_ASSERT_EQUAL(0, DEBUG_MODULE_EVT_HANDLER((struct event_header *)app_module_event));

	free(app_module_event);
}

void test_memfault_data_trigger_fix(void)
{
	setup_debug_module_in_init_state();

	__wrap__event_submit_ExpectAnyArgs();

	/* Update this function to expect the search time and number of satellites. */
	__wrap_memfault_metrics_heartbeat_set_unsigned_ExpectAndReturn(
						MEMFAULT_METRICS_KEY(GpsTimeToFix),
						60000,
						0);
	__wrap_memfault_metrics_heartbeat_set_unsigned_ExpectAndReturn(
						MEMFAULT_METRICS_KEY(GPSFixSatellitesTracked),
						4,
						0);
	__wrap_memfault_metrics_heartbeat_debug_trigger_Ignore();

	struct gps_module_event *gps_module_event = new_gps_module_event();

	gps_module_event->type = GPS_EVT_DATA_READY;
	gps_module_event->data.gps.satellites_tracked = 4;
	gps_module_event->data.gps.search_time = 60000;

	TEST_ASSERT_EQUAL(0, DEBUG_MODULE_EVT_HANDLER((struct event_header *)gps_module_event));

	free(gps_module_event);
}

void test_memfault_data_trigger_timeout(void)
{
	setup_debug_module_in_init_state();

	__wrap__event_submit_ExpectAnyArgs();

	/* Update this function to expect the search time and number of satellites. */
	__wrap_memfault_metrics_heartbeat_set_unsigned_ExpectAndReturn(
						MEMFAULT_METRICS_KEY(GpsTimeoutSearchTime),
						30000,
						0);
	__wrap_memfault_metrics_heartbeat_set_unsigned_ExpectAndReturn(
						MEMFAULT_METRICS_KEY(GpsTimeoutSatellitesTracked),
						2,
						0);
	__wrap_memfault_metrics_heartbeat_debug_trigger_Ignore();

	struct gps_module_event *gps_module_event = new_gps_module_event();

	gps_module_event->type = GPS_EVT_TIMEOUT;
	gps_module_event->data.gps.satellites_tracked = 2;
	gps_module_event->data.gps.search_time = 30000;

	TEST_ASSERT_EQUAL(0, DEBUG_MODULE_EVT_HANDLER((struct event_header *)gps_module_event));

	free(gps_module_event);
}

void test_memfault_data_trigger_unhandled_event(void)
{
	setup_debug_module_in_init_state();

	__wrap__event_submit_ExpectAnyArgs();

	struct gps_module_event *gps_module_event = new_gps_module_event();

	gps_module_event->type = GPS_EVT_ACTIVE;

	TEST_ASSERT_EQUAL(0, DEBUG_MODULE_EVT_HANDLER((struct event_header *)gps_module_event));

	free(gps_module_event);
}

void test_memfault_data_trigger_data_send_trigger(void)
{
	setup_debug_module_in_init_state();

	__wrap__event_submit_ExpectAnyArgs();

	__wrap_memfault_packetizer_data_available_ExpectAndReturn(1);
	__wrap_memfault_packetizer_get_chunk_ExpectAnyArgsAndReturn(1);
	__wrap_memfault_packetizer_get_chunk_ExpectAnyArgsAndReturn(0);

	/* Expect the gps module to generate an event with the fix data. */
	__wrap__event_submit_Stub(&validate_debug_data_ready_evt);

	struct data_module_event *data_module_event = new_data_module_event();

	data_module_event->type = DATA_EVT_DATA_SEND;

	TEST_ASSERT_EQUAL(0, DEBUG_MODULE_EVT_HANDLER((struct event_header *)data_module_event));

	free(data_module_event);
}

void main(void)
{
	(void)unity_main();
}
```
