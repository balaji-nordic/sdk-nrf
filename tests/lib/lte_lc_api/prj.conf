## CMakeLists.txt
```
#
# Copyright (c) 2022 Nordic Semiconductor
#
# SPDX-License-Identifier: LicenseRef-Nordic-5-Clause
#

cmake_minimum_required(VERSION 3.20.0)

find_package(Zephyr REQUIRED HINTS $ENV{ZEPHYR_BASE})
project(lte_lc_api_test)

# generate runner for the test
test_runner_generate(src/lte_lc_api_test.c)

cmock_handle(${ZEPHYR_NRFXLIB_MODULE_DIR}/nrf_modem/include/nrf_modem_at.h)

# When mocking nrf_modem_at then nrf_modem/include must manually be added
# because CONFIG_NRF_MODEM_LINK_BINARY=n
zephyr_include_directories(${ZEPHYR_NRFXLIB_MODULE_DIR}/nrf_modem/include/)
zephyr_include_directories(../../../lib/lte_link_control/)

# add test file
target_sources(app PRIVATE src/lte_lc_api_test.c)
```

## prj.conf
```kconfig
#
# Copyright (c) 2022 Nordic Semiconductor ASA
#
# SPDX-License-Identifier: LicenseRef-Nordic-5-Clause
#

CONFIG_UNITY=y
CONFIG_RING_BUFFER=n
CONFIG_ASSERT=y
CONFIG_HEAP_MEM_POOL_SIZE=5120
CONFIG_COVERAGE_GCOV=y

CONFIG_LTE_LINK_CONTROL=y
CONFIG_LTE_NETWORK_TIMEOUT=2

# Enable logs if you want to explore them
CONFIG_LOG=y
CONFIG_STACK_SENTINEL=y
CONFIG_STACK_CANARIES=y
CONFIG_ENTROPY_GENERATOR=y
```

## src/functions_to_mock.h
```c
/*
 * Copyright (c) 2022 Nordic Semiconductor ASA
 *
 * SPDX-License-Identifier: LicenseRef-Nordic-5-Clause
 */

#include <nrf_modem_at.h>

int nrf_modem_at_notif_handler_set(nrf_modem_at_notif_handler_t callback);


int nrf_modem_at_printf(const char *fmt, ...);


int nrf_modem_at_cmd(void *buf, size_t len, const char *fmt, ...);


int nrf_modem_at_cmd_async(nrf_modem_at_resp_handler_t callback, const char *fmt, ...);


int nrf_modem_at_err_type(int error);


int nrf_modem_at_err(int error);


int nrf_modem_at_cmd_filter_set(const struct nrf_modem_at_cmd_filter *filters,
		size_t len);
```
